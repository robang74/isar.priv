## meta-isar/conf/machine/creator-ci40-marduk.conf
```bitbake
#
# Copyright (c) Mentor Graphics, a Siemens business, 2019
#
# SPDX-License-Identifier: MIT

DISTRO_ARCH ?= "mipsel"

KERNEL_NAME ?= "mainline"
KERNEL_DEFCONFIG ?= "pistachio_defconfig"
KERNEL_DTB_DIR = "boot"
KBUILD_DEPENDS_append = " u-boot-tools:native "

IMAGE_TYPE ?= "ext4-img"
```

## meta/conf/layer.conf
```bitbake
# This software is a part of ISAR.
# Copyright (C) 2015-2016 ilbers GmbH

# We have a conf and classes directory, add to BBPATH
BBPATH .= ":${LAYERDIR}"

# We have recipes-* directories, add to BBFILES
BBFILES +=  "${LAYERDIR}/recipes-*/*/*.bb"

BBFILE_COLLECTIONS += "core"
BBFILE_PATTERN_core = "^${LAYERDIR}/"
BBFILE_PRIORITY_core = "5"

LAYERSERIES_CORENAMES = "v0.6 next"

# This should only be incremented on significant changes that will
# cause compatibility issues with other layers
LAYERVERSION_core = "1"
LAYERSERIES_COMPAT_core = "v0.6"

LAYERDIR_core = "${LAYERDIR}"

ROOTFS_TAR_EXCLUDE_OPTS = '\
    --exclude="proc/*" --exclude="var/log/*" --exclude="var/cache/*" --exclude="var/backups/*" \
    --exclude="var/tmp/*" --exclude="var/crash/*" --exclude="var/spool/*" --exclude="var/lib/apt/*" \
    --exclude="tmp/*" --exclude="sys/*" --exclude-caches --exclude-backups'

ROOTFS_TAR_ZSTD_OPTS = "--no-progress -${SSTATE_ZSTD_CLEVEL} --exclude-compressed --adapt -T${ZSTD_THREADS}"
```
